## meta-k8s-cluster/conf/layer.conf
```bitbake
# We have a conf and classes directory, add to BBPATH
BBPATH .= ":${LAYERDIR}"

# We have recipes-* directories, add to BBFILES
BBFILES += "${LAYERDIR}/recipes-*/*/*.bb \
            ${LAYERDIR}/recipes-*/*/*.bbappend"

BBFILE_COLLECTIONS += "meta-k8s-cluster"
BBFILE_PATTERN_meta-k8s-cluster = "^${LAYERDIR}/"
BBFILE_PRIORITY_meta-k8s-cluster = "6"

LAYERDEPENDS_meta-k8s-cluster = "core"
LAYERSERIES_COMPAT_meta-k8s-cluster = "hardknott"

# Configure the cluster
PATH_TO_DYNAMIC_LAYER = "${THISDIR}/../../../meta-k8s-cluster-images/recipes-nodes/nodes/images/"
MK_K8S_NODES = "master0 master1 master2"
```

## meta-k8s-setup/conf/layer.conf
```bitbake
# We have a conf and classes directory, add to BBPATH
BBPATH .= ":${LAYERDIR}"

# We have recipes-* directories, add to BBFILES
BBFILES += "${LAYERDIR}/recipes-*/*/*.bb \
            ${LAYERDIR}/recipes-*/*/*.bbappend"

BBFILE_COLLECTIONS += "meta-k8s-setup"
BBFILE_PATTERN_meta-k8s-setup = "^${LAYERDIR}/"
BBFILE_PRIORITY_meta-k8s-setup = "6"
# Additional license directories.
LICENSE_PATH += "${LAYERDIR}/custom-licenses"

LAYERDEPENDS_meta-k8s-setup = "core"
LAYERSERIES_COMPAT_meta-k8s-setup = "honister"
```

## meta-k8s-setup/conf/machine/mukube.conf
```bitbake
#@TYPE: Machine
#@NAME: mukube (x86_64)
#@DESCRIPTION: Machine configuration for mukube.

include conf/machine/genericx86-64.conf
# Add tpm2 for using the tpm for unlocking the encrypted partition
MACHINE_FEATURES += "vfat"
MACHINEOVERRIDES =. "genericx86-64:"
```

## meta-k8s-testing/conf/layer.conf
```bitbake
# We have a conf and classes directory, add to BBPATH
BBPATH .= ":${LAYERDIR}"

# We have recipes-* directories, add to BBFILES
BBFILES += "${LAYERDIR}/recipes-*/*/*.bb \
            ${LAYERDIR}/recipes-*/*/*.bbappend"

BBFILE_COLLECTIONS += "meta-k8s-testing"
BBFILE_PATTERN_meta-k8s-testing = "^${LAYERDIR}/"
BBFILE_PRIORITY_meta-k8s-testing = "6"

LAYERDEPENDS_meta-k8s-testing = "core"
LAYERSERIES_COMPAT_meta-k8s-testing = "hardknott"
```

## meta-network/conf/layer.conf
```bitbake
# We have a conf and classes directory, add to BBPATH
BBPATH .= ":${LAYERDIR}"

# We have recipes-* directories, add to BBFILES
BBFILES += "${LAYERDIR}/recipes-*/*/*.bb \
            ${LAYERDIR}/recipes-*/*/*.bbappend"

BBFILE_COLLECTIONS += "meta-network"
BBFILE_PATTERN_meta-network = "^${LAYERDIR}/"
BBFILE_PRIORITY_meta-network = "6"

LAYERDEPENDS_meta-network = "core"
LAYERSERIES_COMPAT_meta-network = "hardknott"
```

## meta-secure-boot/conf/layer.conf
```bitbake
# We have a conf and classes directory, add to BBPATH
BBPATH .= ":${LAYERDIR}"

# We have recipes-* directories, add to BBFILES
BBFILES += "${LAYERDIR}/recipes-*/*/*.bb \
            ${LAYERDIR}/recipes-*/*/*.bbappend"

BBFILE_COLLECTIONS += "secure-boot"
BBFILE_PATTERN_secure-boot = "^${LAYERDIR}/"
BBFILE_PRIORITY_secure-boot = "5"

LAYERSERIES_COMPAT_secure-boot = "hardknott"
```

## yocto/meta-k8s-setup/conf/layer.conf
```bitbake
# We have a conf and classes directory, add to BBPATH
BBPATH .= ":${LAYERDIR}"

# We have recipes-* directories, add to BBFILES
BBFILES += "${LAYERDIR}/recipes-*/*/*.bb \
            ${LAYERDIR}/recipes-*/*/*.bbappend"

BBFILE_COLLECTIONS += "meta-demo"
BBFILE_PATTERN_meta-demo = "^${LAYERDIR}/"
BBFILE_PRIORITY_meta-demo = "6"

LAYERDEPENDS_meta-demo = "core"
LAYERSERIES_COMPAT_meta-demo = "hardknott"
```
